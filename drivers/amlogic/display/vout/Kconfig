## drivers/amlogic/display/vout/Kconfig
```kconfig
#
# Video output configuration
#
menu "Amlogic video output module"

config AM_TV_OUTPUT
	tristate "TV output"
	default y
	help  
		tv output module

config AM_LCD_OUTPUT
	tristate "LCD output" 
	default y
	help  
		LCD output module

endmenu
	
```

## drivers/amlogic/efuse/Kconfig
```kconfig
#
# Amlogic efuse device configuration
#

menu "Amlogic EFUSE Support"

config EFUSE
	bool "EFUSE Driver"
	default n
	help
	    EFUSE device driver.

endmenu
```

## drivers/amlogic/i2c/Kconfig
```kconfig
menu  "Amlogic I2C Hardware Bus support"
    depends on PLAT_MESON
config I2C_AML
        bool "Amlogic I2C Driver"
        select I2C
        select I2C_CHARDEV
        select I2C_ALGOBIT
	help
          Yet another Amlogic I2C Driver, normal master

config I2C_SW_AML
        bool "Amlogic software I2C Driver"
        select I2C
        select I2C_CHARDEV
        select I2C_ALGOBIT
	help
          Amlogic software I2C Driver, normal gpio simulate I2C, bit algo
endmenu
```

## drivers/amlogic/input/Kconfig
```kconfig
#
# Input device configuration
#

menu "Meson Input device support"

source "drivers/amlogic/input/saradc/Kconfig"
source "drivers/amlogic/input/remote/Kconfig"
source "drivers/amlogic/input/keyboard/Kconfig"
source "drivers/amlogic/input/touchscreen/Kconfig"
source "drivers/amlogic/input/simcard_detect/Kconfig"

endmenu
```

## drivers/amlogic/mali/Kconfig
```kconfig
menu "Mali GPU OpenGL device driver"
config MALI400
	tristate "Mali support"
	depends on m
	default m
	select FB
	---help---
	  This enables support for the Mali-300, Mali-400, and Mali-450 GPUs.

	  To compile this driver as a module, choose M here: the module will be
	  called mali.
choice
	prompt "Mali frequency"
	default MALI_CLK_333M
	depends on ARCH_MESON6 
	depends on MALI400
	
config MALI_CLK_400M
	bool "Mali clock 400M"
	help	
		Mali clock set to 400M
config MALI_CLK_333M
	bool"Mali clock 333M"
	help
		Mali clock set to 333M
config MALI_CLK_250M
	bool"Mali clock 250M"
	help
		Mali clock set to 250M		

endchoice

config MALI400_DEBUG
	bool "Enable debug in Mali driver"
	depends on MALI400
	---help---
	  This enabled extra debug checks and messages in the Mali-300/400/450
	  driver.

config MALI400_PROFILING
	bool "Enable Mali profiling"
	depends on MALI400 && TRACEPOINTS
	---help---
	  This enables gator profiling of Mali GPU events.

config MALI400_GPU_UTILIZATION
	bool "Enable Mali GPU utilization tracking"
	depends on MALI400
	---help---
	  This enables gathering and processing of the utilization of Mali GPU.
	  This data can be used as a basis to change GPU operating frequency.
	  
endmenu
```

## drivers/amlogic/mmc/Kconfig
```kconfig
#
# MMC/SD host controller drivers
#

comment "MMC/SD/SDIO Host Controller Drivers"

menu "Amlogic Multimedia Card support"

config MMC_AML
	bool "Amlogic Multimedia Card support"
	default y
	select MMC
	select MMC_BLOCK
	select MMC_BLOCK_BOUNCE
	select EXT2_FS
	select EXT3_FS
	select EXFAT_FS
	select FAT_FS
	select MSDOS_FS
	select VFAT_FS
	select NTFS_FS
	select NLS
	select NLS_CODEPAGE_437
	select NLS_ISO8859_1
	select NLS_UTF8
	
endmenu
```

## drivers/amlogic/nand/Kconfig
```kconfig
#
# Amlogic NAND device configuration
#

menu "Meson NAND Device Support"

config AM_NAND
	bool "Meson NAND flash device"
	default n
	select MTD_NAND
	select MTD_PARTITIONS
	select MTD_BLOCK
	select MTD_CHAR
	select MTD
	help
	  Support for NAND flash on Amlogic Meson platforms

config AM_NAND_RBPIN
	bool "Meson NAND RB bit support"
	depends on AM_NAND
	depends on ARCH_MESON3 || ARCH_MESON6
	default y
	help
	  Support NAND RB bit

config AML_NAND_ENV
	bool "Meson NAND environment variable device (dev/nand_env) support"
	depends on AM_NAND
	depends on ARCH_MESON3 || ARCH_MESON6
	default y
	help
	  Support NAND environment variable device

config AML_NFTL
	tristate "Meson NAND FTL support"
	depends on AM_NAND
	default m
	help
	  Support NAND Flash Translation Layer

endmenu
```

## drivers/amlogic/power/Kconfig
```kconfig
menu "Amlogic Power Management Support"

config AMLOGIC_PM
	bool "Amlogic Power support"
	select POWER_SUPPLY
	default n
	help
	  Say Y here if you want to use the Amlogic power management.

config SMBA10XX_BATTERY
	boolean "SMBA10XX battery driver support"
	select I2C
	default n
	help
	  Say Y if you want to add battery driver supoort for SMBA10XX
	  
config BQ27x00_BATTERY
	bool "BQ27x00 Battery support"
	select POWER_SUPPLY
	select I2C
	default n
	help
	  Say Y here if you want to add battery driver supoort for bq27x00.

source "drivers/amlogic/power/act8xxx_pmu/Kconfig"
source "drivers/amlogic/power/axp_power/Kconfig"
source "drivers/amlogic/power/meson_cs_dcdc_regulator/Kconfig"
endmenu
```

## drivers/amlogic/power/act8xxx_pmu/Kconfig
```kconfig
config PMU_ACT8xxx
	bool "PMU ACT driver support "
	select POWER_SUPPLY
	select I2C
	help
	  pmu act8942(with charging management).

choice 
	prompt "Select ACT driver"
	depends on PMU_ACT8xxx
	default PMU_ACT8862
config PMU_ACT8942
	bool "PMU ACT8942(with charging management)"
	help
	  pmu act8942(with charging management).

config PMU_ACT8862
	bool "PMU ACT8862(without charging management)"
	help
	  pmu act8862(without charging management).

endchoice
```

## drivers/amlogic/ppmgr/Kconfig
```kconfig
#
# Post Process Manager device configuration
#

menu "Amlogic Post Process Manager driver"

config POST_PROCESS_MANAGER
    tristate "Amlogic Post Process Manager driver"
    default n
	help
	  Select to enable Amlogic Post Process Manager driver.
config POST_PROCESS_MANAGER_PPSCALER
    tristate "Amlogic Post Process Manager PPScaler mode"
    depends on  POST_PROCESS_MANAGER
    default n
	help
	  Select to include PPscaler function in Amlogic Post Process Manager driver.
endmenu
```

## drivers/amlogic/rtc/Kconfig
```kconfig
# Amlogic RTC


config AML_RTC
    bool "Amlogic RTC support"
    default y
    select RTC_CLASS
    help
      This is the Amlogic internal RTC driver
      
```

## drivers/amlogic/sensors/Kconfig
```kconfig
menuconfig AM_SENSORS
	bool "Amlogic Sensors support"
	default n

if AM_SENSORS

config MPU3050
	bool "InvenSense MPU-3050 6-axis sensor"
	depends on MISC_DEVICES
	default n
	help
	 Invensense mpu3050 sensors
	source "drivers/amlogic/sensors/mpu3050/Kconfig"

config LIGHT_SENSOR
	bool "LightSensor"
	depends on INPUT
	default n
	help
	 GL3526 Light Sensor
	 	 
endif # AM_SENSORS
```

## drivers/amlogic/sensors/lightsensor/Kconfig
```kconfig
menu "Amlogic Light Sensors"

config LS_GL3526
	bool "ADC Light Sensor - GL3526"
	select INPUT_POLLDEV
	default n
	---help---
	  This module adds support for ADC light sensor GL3526

endmenu
```

## drivers/amlogic/tuners/Kconfig
```kconfig
#
# Amlogic tvin devices configuration
#

menuconfig TVIN_TUNER
	bool "Amlogic TVIN Tuner Support"
	default n
	help
		TVIN Tuner Driver.

choice
	prompt "Tuner Type"
	depends on TVIN_TUNER
	default TVIN_TUNER_FQ1216ME
	help
	  Select the tuner device type.

	config TVIN_TUNER_FQ1216ME
		bool "Philips FQ1216ME"
		help
			PHILIPS FQ1216ME tuner driver.

	config TVIN_TUNER_HTM9AW125
		bool "Xuguang HTM-9A/W125"
		help
			Xuguang HTM-9A/W125 tuner driver.

	config TVIN_TUNER_SI2176
		bool "Silicon Labs si2176"
		help
			Silicon Labs si2176 tuner driver.

endchoice
```

## drivers/amlogic/tvin/Kconfig
```kconfig
#
# Amlogic tvin devices configuration
#


menu "Amlogic TVIN Support"

config TVIN_HDMI
	tristate "Amlogic TVIN HDMIRX device"
	default n
	help
		HDMI device driver.

config TVIN_AFE
	tristate "Amlogic TVIN TVAFE device"
	depends on !ARCH_MESON1
	default n
	help
		AFE device driver.

config TVIN_VDIN
	tristate "Amlogic TVIN VDIN device"
	default n
	help
		VDIN devices driver.

endmenu
```

## drivers/amlogic/ump/Kconfig
```kconfig
#
# Mali 400 GPU OpenGL device driver
#

menu "Mali 400 UMP device driver"

config UMP
	tristate "Mali 400 UMP device driver"
	depends on MODULES
	default m
	help
	  Enable kernel module build for Mali 400 Unified Memory Provider device driver.

endmenu
```

## drivers/amlogic/usb/Kconfig
```kconfig
menu "Amlogic USB Support"

config USB_DWC_OTG_HCD
	bool "Amlogic USB host controller dwc_otg support"
	select USB
	help
	   dwc_otg USB host controller

config USB_HOST_ELECT_TEST
	bool "USB High speed electric test support"
	depends on USB_DWC_OTG_HCD
	default y
	help
	    Enable this config to support USB High speed electric test.

config DWC_USB_NAK_IN_TIMER
	bool "Disable DWC OTG USB NAK ISR"
	depends on USB_DWC_OTG_HCD
	default n
	help
		[y]Enable this config to disable DWC OTG USB NAK interrupt handler.
			 The handler is moved to timer.
		[n]Disable this config to let NAK handler in interrupt.
		Don't change this if you don't know what it is.

endmenu
```

## sound/soc/aml/Kconfig
```kconfig
config SND_AML_SOC
	tristate "Audio for Amlogic Meson SoC"
	depends on PLAT_MESON
	help
	  Say Y or M if you want to add support for codecs attached to
	  the Amlogic I2S interface. You will also need
	  to select the audio interfaces to support below.

config SND_AML_M1
	tristate "M1 evaluation board with internel audio dac"
	depends on SND_AML_SOC
	depends on ARCH_MESON1

config SND_AML_M1_MID_WM8900
	tristate "AML6236 MID board with WM8900"
	depends on SND_AML_SOC
        select SND_SOC_WM8900 if SND_AML_M1_MID_WM8900

config SND_AML_M1_ARMDEV_WM8900
	tristate "AML8726M ARM Dev board with WM8900"
	depends on SND_AML_SOC
	select SND_SOC_WM8900 if SND_AML_M1_ARMDEV_WM8900

config SND_AML_M1_MID_RT5621
	tristate "AML8726M MID board with RT5621"
	depends on SND_AML_SOC
	select SND_SOC_RT5621 if SND_AML_M1_MID_RT5621

config SND_AML_M2
	tristate "M2 evaluation board with internal audio codec"
	depends on SND_AML_SOC
	depends on ARCH_MESON2

config SND_AML_M3
	tristate "M3 evaluation board with internal audio codec"
	depends on SND_AML_SOC
	depends on ARCH_MESON3

config SND_AML_M6_RT5631
	tristate "M6 evaluation board with RT56331"
	depends on SND_AML_SOC
	select SND_SOC_RT5631 if SND_AML_M6_RT5631

config SND_AML_M6_WM8960
	tristate "M6 evaluation board with WM8960"
	depends on SND_AML_SOC
	select SND_SOC_WM8960 if SND_AML_M6_WM8960

config SND_AML_M_DUMMY_CODEC
    tristate "AML M series board with DUMMY_CODEC"
    depends on SND_AML_SOC
    select SND_SOC_DUMMY_CODEC if SND_AML_M_DUMMY_CODEC
```
