## customer/drivers/net/usb/Kconfig
```kconfig
#
# USB Network devices configuration
#
comment "Networking support is needed for USB Network Adapter support"
	depends on USB && !NET

menu "USB Network Adapters"
	depends on USB && NET
	  
config USB_NET_QF9700
	tristate "QF9700 based Ethernet adapters"
	depends on USB_USBNET
	help
	  Choose this option if you're using a 10/100 Ethernet USB2
	  adapter based on the QF9700 controller. This includes
	  adapters marketed under the DeLOCK brand.
config USB_NET_SR9600
	tristate "SR9600 based Ethernet adapters"
	depends on USB_USBNET
	help
	  Choose this option if you're using a 10/100 Ethernet USB2
	  adapter based on the SR9600 controller. This includes
	  adapters marketed under the DeLOCK brand.
	  
endmenu
```

## customer/drivers/touchscreen/Kconfig
```kconfig
#
# Touchscreen driver configuration
#

menuconfig MESON_INPUT_TOUCHSCREEN
	bool "Touchscreens"
	help
	  Say Y here, and a list of supported touchscreens will be displayed.
	  This option doesn't affect the kernel.

	  If unsure, say Y.

if MESON_INPUT_TOUCHSCREEN

config FOCALTECH_CAPACITIVE_TOUCHSCREEN_G06
	tristate "FocalTech I2C capacitive touchscreen for g06"
	depends on I2C
	default n
	help
	  Say Y here if you want to use the FocalTech 5X06 capacitive panel.
	  
endif # MESON_INPUT_TOUCHSCREEN
```

## drivers/amlogic/Kconfig
```kconfig
#
# Amlogic driver configuration
#
menu "Amlogic Device Drivers"
	depends on PLAT_MESON


#
#	Char devices
#
comment "Char devices"
source "drivers/amlogic/uart/Kconfig"
source "drivers/amlogic/rtc/Kconfig"
source "drivers/amlogic/i2c/Kconfig"
source "drivers/amlogic/input/Kconfig"
source "drivers/amlogic/power/Kconfig"
#source "drivers/amlogic/extern_io/Kconfig"
#source "drivers/amlogic/gpio/Kconfig"
#source "drivers/amlogic/minilvds/Kconfig"
source "drivers/amlogic/efuse/Kconfig"
#source "drivers/amlogic/smartcard/Kconfig"
source "drivers/amlogic/gps/Kconfig"
#source "drivers/amlogic/modem/Kconfig"
source "drivers/amlogic/debug/Kconfig"
source "drivers/amlogic/sensors/Kconfig"
source "drivers/amlogic/boot_monitor/Kconfig"

#
#	Block devices
#
comment "Block devices"
source "drivers/amlogic/usb/Kconfig"
#source "drivers/amlogic/sata/Kconfig"
source "drivers/amlogic/cardreader/Kconfig"
source "drivers/amlogic/mmc/Kconfig"
source "drivers/amlogic/spi_nor/Kconfig"
source "drivers/amlogic/nand/Kconfig"
#source "drivers/amlogic/demod/Kconfig"


#
#	Network devices
#
comment "Network devices"
source "drivers/amlogic/ethernet/Kconfig"
source "drivers/amlogic/wifi/Kconfig"
source "drivers/amlogic/bluetooth/Kconfig"

#
#	Media devices
#
comment "Media devices"
#
#  Audio
#
source "drivers/amlogic/amports/Kconfig"
source "drivers/amlogic/amaudio/Kconfig"
source "drivers/amlogic/audiodsp/Kconfig"
#
#  Video
#
source "drivers/amlogic/canvas/Kconfig"
source "drivers/amlogic/display/Kconfig"
source "drivers/amlogic/hdmi/Kconfig"
#source "drivers/amlogic/tvin/Kconfig"
source "drivers/amlogic/tvin_camera/Kconfig"
#source "drivers/amlogic/cmem/Kconfig"
#source "drivers/amlogic/jpeglogo/Kconfig"
#source "drivers/amlogic/dvb/Kconfig"
source "drivers/amlogic/ppmgr/Kconfig"
source "drivers/amlogic/camera/Kconfig"
source "drivers/amlogic/deinterlace/Kconfig"

#3G module power manager
source "drivers/amlogic/modem/Kconfig"

#
#	ARM Mali
#
comment "ARM Mali"
source "drivers/amlogic/ump/Kconfig"
source "drivers/amlogic/mali/Kconfig"
endmenu	
```

## drivers/amlogic/amports/Kconfig
```kconfig
#
# Amlogic streaming device configuration
#
config  AM_PTSSERVER
	bool 
	default n
config AM_VIDEO
	bool "Amlogic Video management"
	default n
	select AM_CANVAS
	select AM_PTSMGR
	select AM_TIMESYNC
	select AM_PTSSERVER
	help
	  Driver for video display.

config AM_VIDEO2
	bool "AMLOGIC Video2 management"
	default n
	select AM_VIDEO
	help
	  Driver for video2 display.

menu "Video Decoders"
	depends on AM_VIDEO
config AM_VDEC_MPEG12
	tristate "Amlogic MPEG1/2 Video Decoder"
	default y
	
	select AM_PTSSERVER
	help
	  Driver for mpeg1/2 video decoder.

config AM_VDEC_MPEG4
	tristate "Amlogic MPEG4 Video Decoder"
	default y
	
	select AM_PTSSERVER
	help
	  Driver for mpeg4 video decoder.

config AM_VDEC_VC1
	tristate "Amlogic VC1 Video Decoder"
	default y
	
	select AM_PTSSERVER
	help
	  Driver for vc1 video decoder.

config AM_VDEC_H264
	tristate "Amlogic H264 Video Decoder"
	default y
	
	select AM_PTSSERVER
	help
	  Driver for h264 video decoder.

config AM_VDEC_H264MVC
	tristate "Amlogic H264MVC Video Decoder"
	default n
	
	select AM_PTSSERVER
	help
	  Driver for h264mvc video decoder.

config AM_VDEC_MJPEG
	tristate "Amlogic Motion JPEG Video Decoder"
	default y
	
	select AM_PTSSERVER
	help
	  Driver for motion jpeg video decoder.

config AM_VDEC_REAL
	tristate "Amlogic Real Video Decoder"
    default y
    
	select AM_PTSSERVER
    help
      Driver for real video decoder.

config AM_JPEGDEC
    tristate "Amlogic HW jpeg decoder"
    default y
    
	select AM_PTSSERVER
	help
	  Select to enable HW jpeg decoder.

config AM_TIMESYNC
	bool "Amlogic Time sync driver"
	default y
	help
	  AV sync and play rate control management.

config AM_STREAMING
	bool "Amlogic AV Streaming support"
	default y
	select AM_PTSSERVER
	help
	  Driver for the AV streaming ports.

config AM_SUBTITLE
	bool "Amlogic SubTitle support"
	default y
	help 
		Internal Sub Title support driver
endmenu
```

## drivers/amlogic/bluetooth/Kconfig
```kconfig
menu "Amlogic BT Device Support"

config BT_DEVICE
    bool "BT Device support"
    depends on BT && RFKILL
    select BACKLIGHT_CLASS_DEVICE
    default n
    help
      Say Y here if you want to use the BT device.

config BCM4329_BT
    bool "BCM4329 bt support"
    depends on BT_DEVICE
    help
        Say y here if you want to use BCM4329 BT.
    
endmenu
```

## drivers/amlogic/boot_monitor/Kconfig
```kconfig
menu "Amlogic BOOT MONITOR SYSFS"

config BOOT_MONITOR
	bool "BOOT MONITOR SYSFS"
	depends on ARCH_MESON6
	default n
	---help---
	  This module adds support for boot monitor sysfs.

endmenu
```

## drivers/amlogic/canvas/Kconfig
```kconfig
#
# Canvas management driver configuration
#

menu "Amlogic Canvas management driver"

config AM_CANVAS
    bool "Amlogic Canvas management driver"
    default y
	help
	  Select to enable Canvas management driver.

endmenu
```

## drivers/amlogic/debug/Kconfig
```kconfig
#
# Amlogic display driver configuration
#
menu "Amlogic debug support"
config AM_DEBUG
    bool "Debug enable" 
    default n
    help 
	"we have many debug part log,kprobe etc. this item will enable or disable all "
config AM_KPROBE_MODULE
    depends on AM_DEBUG
    tristate "Enable aml kprobe module"
	default n
	select KPROBES
	select KALLSYMS_ALL
	select DEBUG_FS
	help 
	"aml kprobe module for debug"
endmenu
```

## drivers/amlogic/display/Kconfig
```kconfig
#
# Amlogic display driver configuration
#
menu "Amlogic Display Driver"

config AM_DISPLAY_MODULE
	bool "Enable aml display module"
	default y
	help 
	"display include logo,ge2d vout etc."
if  AM_DISPLAY_MODULE
source "drivers/amlogic/display/vout/Kconfig"
source "drivers/amlogic/display/vout2/Kconfig"

source "drivers/amlogic/display/osd/Kconfig"
source "drivers/amlogic/display/backlight/Kconfig"
source "drivers/amlogic/display/ge2d/Kconfig"
source "drivers/amlogic/display/aml_logo/Kconfig"
endif		

endmenu	
```

## drivers/amlogic/display/aml_logo/Kconfig
```kconfig
config  AM_LOGO
	bool  "setup logo"
	default n
	depends on FB_AM && AM_GE2D
	help 
		setup logo support osd parameter offered by Uboot 
```
