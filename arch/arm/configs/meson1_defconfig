## arch/arm/configs/meson1_defconfig
```kconfig
CONFIG_EXPERIMENTAL=y
# CONFIG_SWAP is not set
CONFIG_SYSVIPC=y
CONFIG_BSD_PROCESS_ACCT=y
CONFIG_TINY_RCU=y
CONFIG_LOG_BUF_SHIFT=14
CONFIG_CGROUPS=y
CONFIG_CGROUP_FREEZER=y
CONFIG_CGROUP_CPUACCT=y
CONFIG_RESOURCE_COUNTERS=y
CONFIG_CGROUP_SCHED=y
# CONFIG_FAIR_GROUP_SCHED is not set
CONFIG_RT_GROUP_SCHED=y
CONFIG_ASHMEM=y
# CONFIG_AIO is not set
CONFIG_EMBEDDED=y
# CONFIG_VM_EVENT_COUNTERS is not set
CONFIG_MODULES=y
CONFIG_MODULE_UNLOAD=y
# CONFIG_LBDAF is not set
# CONFIG_BLK_DEV_BSG is not set
# CONFIG_IOSCHED_CFQ is not set
CONFIG_MESON_LEGACY_REGISTER_API=y
CONFIG_ARCH_MESON1=y
CONFIG_MACH_M1_8626M_REFC02=y
CONFIG_MACH_M1_8726M_REFC03=y
CONFIG_NO_HZ=y
CONFIG_HIGH_RES_TIMERS=y
CONFIG_PREEMPT=y
CONFIG_AEABI=y
CONFIG_CPU_IDLE=y
CONFIG_VFP=y
CONFIG_NEON=y
CONFIG_BINFMT_MISC=y
CONFIG_NET=y
CONFIG_PACKET=y
CONFIG_UNIX=y
CONFIG_NET_KEY=y
CONFIG_INET=y
CONFIG_IP_MULTICAST=y
CONFIG_IP_PNP=y
CONFIG_IP_PNP_DHCP=y
CONFIG_IP_PNP_BOOTP=y
CONFIG_IP_PNP_RARP=y
CONFIG_IPV6=y
# CONFIG_AML_RTC is not set
CONFIG_I2C_AML=y
CONFIG_AM_REMOTE=y
# CONFIG_MMC_AML is not set
CONFIG_AM_ETHERNET=y
CONFIG_AM_VIDEO=y
CONFIG_AM_VDEC_H264MVC=y
# CONFIG_AMAUDIO is not set
CONFIG_AML_AUDIO_DSP=y
# CONFIG_AM_LCD_OUTPUT is not set
CONFIG_FB_AM=y
CONFIG_FB_OSD2_CURSOR=y
CONFIG_AM_GE2D=y
CONFIG_UEVENT_HELPER_PATH="/sbin/mdev"
CONFIG_DEVTMPFS=y
CONFIG_DEVTMPFS_MOUNT=y
CONFIG_BLK_DEV_LOOP=y
CONFIG_SCSI=y
CONFIG_MD=y
CONFIG_BLK_DEV_DM=y
CONFIG_DM_CRYPT=y
CONFIG_DM_UEVENT=y
CONFIG_NETDEVICES=y
# CONFIG_NETDEV_1000 is not set
# CONFIG_NETDEV_10000 is not set
# CONFIG_WLAN is not set
CONFIG_INPUT_EVDEV=y
CONFIG_POWER_SUPPLY=y
CONFIG_SOUND=y
CONFIG_SND=y
CONFIG_USB=y
CONFIG_USB_STORAGE=y
CONFIG_USB_STORAGE_DEBUG=y
CONFIG_MMC=y
CONFIG_SWITCH=y
CONFIG_UIO=y
CONFIG_UIO_PDRV=y
CONFIG_STAGING=y
CONFIG_ANDROID=y
CONFIG_ANDROID_BINDER_IPC=y
CONFIG_ANDROID_LOGGER=y
CONFIG_ANDROID_LOW_MEMORY_KILLER=y
CONFIG_EXT2_FS=y
CONFIG_EXT2_FS_XATTR=y
CONFIG_EXT2_FS_POSIX_ACL=y
CONFIG_EXT2_FS_SECURITY=y
CONFIG_EXT2_FS_XIP=y
CONFIG_EXT3_FS=y
CONFIG_EXT3_FS_POSIX_ACL=y
CONFIG_EXT3_FS_SECURITY=y
CONFIG_MSDOS_FS=y
CONFIG_VFAT_FS=y
CONFIG_NTFS_FS=y
CONFIG_NFS_FS=y
CONFIG_NFS_V3=y
CONFIG_NFS_V3_ACL=y
CONFIG_ROOT_NFS=y
CONFIG_NLS_CODEPAGE_437=y
CONFIG_NLS_ISO8859_1=y
CONFIG_NLS_UTF8=y
CONFIG_PRINTK_TIME=y
CONFIG_DEBUG_FS=y
CONFIG_DEBUG_KERNEL=y
# CONFIG_SCHED_DEBUG is not set
CONFIG_TIMER_STATS=y
CONFIG_DEBUG_INFO=y
CONFIG_XZ_DEC=y
```

## arch/arm/configs/meson2_defconfig
```kconfig
CONFIG_EXPERIMENTAL=y
# CONFIG_SWAP is not set
CONFIG_SYSVIPC=y
CONFIG_BSD_PROCESS_ACCT=y
CONFIG_TINY_RCU=y
CONFIG_RCU_TRACE=y
CONFIG_LOG_BUF_SHIFT=14
CONFIG_CGROUPS=y
CONFIG_CGROUP_FREEZER=y
CONFIG_CGROUP_CPUACCT=y
CONFIG_RESOURCE_COUNTERS=y
CONFIG_CGROUP_SCHED=y
# CONFIG_FAIR_GROUP_SCHED is not set
CONFIG_RT_GROUP_SCHED=y
CONFIG_BLK_DEV_INITRD=y
CONFIG_INITRAMFS_SOURCE="/home/bo.yang/out/rootfs/myroot"
CONFIG_ASHMEM=y
# CONFIG_AIO is not set
CONFIG_EMBEDDED=y
# CONFIG_VM_EVENT_COUNTERS is not set
CONFIG_MODULES=y
CONFIG_MODULE_UNLOAD=y
# CONFIG_LBDAF is not set
# CONFIG_BLK_DEV_BSG is not set
# CONFIG_IOSCHED_CFQ is not set
CONFIG_ARCH_MESON2=y
CONFIG_MESON_LEGACY_REGISTER_API=y
# CONFIG_MACH_M2_SKT is not set
CONFIG_MISC_DEVICES=y
CONFIG_NO_HZ=y
CONFIG_HIGH_RES_TIMERS=y
CONFIG_PREEMPT=y
CONFIG_AEABI=y
CONFIG_VFP=y
CONFIG_NEON=y
CONFIG_BINFMT_MISC=y
# CONFIG_AML_RTC is not set
# CONFIG_MESON_INPUT_REMOTE is not set
# CONFIG_MESON_INPUT_KEYBOARD is not set
# CONFIG_MMC_AML is not set
# CONFIG_AMAUDIO is not set
# CONFIG_AM_TV_OUTPUT is not set
# CONFIG_AM_LCD_OUTPUT is not set
# CONFIG_AML_HDMI_TX is not set
# CONFIG_UMP is not set
# CONFIG_MALI is not set
CONFIG_UEVENT_HELPER_PATH="/sbin/mdev"
CONFIG_DEVTMPFS=y
CONFIG_DEVTMPFS_MOUNT=y
CONFIG_BLK_DEV_LOOP=y
CONFIG_LEGACY_PTY_COUNT=10
CONFIG_TTY_PRINTK=y
CONFIG_POWER_SUPPLY=y
CONFIG_FB=y
# CONFIG_USB_SUPPORT is not set
CONFIG_UIO=y
CONFIG_UIO_PDRV=y
CONFIG_EXT2_FS=y
CONFIG_EXT2_FS_XATTR=y
CONFIG_EXT2_FS_POSIX_ACL=y
CONFIG_EXT2_FS_SECURITY=y
CONFIG_EXT2_FS_XIP=y
CONFIG_EXT3_FS=y
CONFIG_EXT3_FS_POSIX_ACL=y
CONFIG_EXT3_FS_SECURITY=y
CONFIG_FUSE_FS=y
CONFIG_MSDOS_FS=y
CONFIG_VFAT_FS=y
CONFIG_NTFS_FS=y
CONFIG_TMPFS=y
CONFIG_TMPFS_POSIX_ACL=y
CONFIG_NLS_CODEPAGE_437=y
CONFIG_NLS_CODEPAGE_936=y
CONFIG_NLS_CODEPAGE_950=y
CONFIG_NLS_ISO8859_1=y
CONFIG_NLS_UTF8=y
CONFIG_PRINTK_TIME=y
CONFIG_DEBUG_FS=y
CONFIG_DEBUG_KERNEL=y
# CONFIG_SCHED_DEBUG is not set
CONFIG_TIMER_STATS=y
CONFIG_DEBUG_INFO=y
CONFIG_CRYPTO=y
CONFIG_CRYPTO_CBC=y
CONFIG_CRYPTO_TWOFISH=y
CONFIG_XZ_DEC=y
```

## arch/arm/configs/meson6_defconfig
```kconfig
CONFIG_EXPERIMENTAL=y
# CONFIG_SWAP is not set
CONFIG_SYSVIPC=y
CONFIG_BSD_PROCESS_ACCT=y
CONFIG_RCU_TRACE=y
CONFIG_LOG_BUF_SHIFT=14
CONFIG_CGROUPS=y
CONFIG_CGROUP_FREEZER=y
CONFIG_CGROUP_CPUACCT=y
CONFIG_RESOURCE_COUNTERS=y
CONFIG_CGROUP_SCHED=y
# CONFIG_FAIR_GROUP_SCHED is not set
CONFIG_RT_GROUP_SCHED=y
CONFIG_BLK_DEV_INITRD=y
CONFIG_ASHMEM=y
# CONFIG_AIO is not set
CONFIG_EMBEDDED=y
# CONFIG_VM_EVENT_COUNTERS is not set
CONFIG_MODULES=y
CONFIG_MODULE_UNLOAD=y
CONFIG_BLOCK=y
CONFIG_LBDAF=y
# CONFIG_BLK_DEV_BSG is not set
CONFIG_BLK_DEV_INTEGRITY=y
# CONFIG_IOSCHED_CFQ is not set
CONFIG_ARCH_MESON6=y
CONFIG_MESON_LEGACY_REGISTER_API=y
CONFIG_ARM_ERRATA_753970=y
CONFIG_NO_HZ=y
CONFIG_HIGH_RES_TIMERS=y
CONFIG_PREEMPT=y
CONFIG_AEABI=y
CONFIG_CPU_IDLE=y
CONFIG_VFP=y
CONFIG_NEON=y
CONFIG_BINFMT_MISC=y
# CONFIG_SUSPEND is not set
# CONFIG_AML_RTC is not set
CONFIG_I2C_AML=y
CONFIG_SARADC_AM=y
# CONFIG_MESON_INPUT_REMOTE is not set
CONFIG_MESON_INPUT_KEYBOARD=y
CONFIG_ADC_KEYPADS_AM=y
# CONFIG_KEY_INPUT_CUSTOM_AM is not set
CONFIG_MESON_INPUT_TOUCHSCREEN=y
CONFIG_GOODIX_GT82X_CAPACITIVE_TOUCHSCREEN=y
CONFIG_EFUSE=y
CONFIG_USB_DWC_OTG_HCD=y
CONFIG_CARDREADER=y
# CONFIG_MMC_AML is not set
# CONFIG_AMAUDIO is not set
CONFIG_AM_LCD_OUTPUT=y
CONFIG_FB_AM=y
# CONFIG_UMP is not set
# CONFIG_MALI is not set
CONFIG_UEVENT_HELPER_PATH="/sbin/mdev"
CONFIG_DEVTMPFS=y
CONFIG_DEVTMPFS_MOUNT=y
CONFIG_SCSI=y
CONFIG_BLK_DEV_SD=y
# CONFIG_UNIX98_PTYS is not set
CONFIG_LEGACY_PTY_COUNT=10
CONFIG_TTY_PRINTK=y
CONFIG_HVC_DCC=y
CONFIG_I2C=y
CONFIG_POWER_SUPPLY=y
# CONFIG_MFD_SUPPORT is not set
CONFIG_MEDIA_SUPPORT=y
CONFIG_SOUND=y
CONFIG_USB_ANNOUNCE_NEW_DEVICES=y
CONFIG_USB_STORAGE=y
CONFIG_UIO=y
CONFIG_UIO_PDRV=y
CONFIG_EXT2_FS=y
CONFIG_EXT2_FS_XATTR=y
CONFIG_EXT2_FS_POSIX_ACL=y
CONFIG_EXT2_FS_SECURITY=y
CONFIG_EXT2_FS_XIP=y
CONFIG_EXT3_FS=y
CONFIG_EXT3_FS_POSIX_ACL=y
CONFIG_EXT3_FS_SECURITY=y
CONFIG_MSDOS_FS=y
CONFIG_VFAT_FS=y
CONFIG_NTFS_FS=y
CONFIG_TMPFS=y
# CONFIG_MISC_FILESYSTEMS is not set
CONFIG_NLS_CODEPAGE_437=y
CONFIG_NLS_CODEPAGE_936=y
CONFIG_NLS_CODEPAGE_950=y
CONFIG_NLS_ISO8859_1=y
CONFIG_NLS_UTF8=y
CONFIG_PRINTK_TIME=y
CONFIG_DEBUG_KERNEL=y
# CONFIG_SCHED_DEBUG is not set
CONFIG_TIMER_STATS=y
CONFIG_DEBUG_INFO=y
CONFIG_CRYPTO=y
CONFIG_CRYPTO_CBC=y
CONFIG_CRYPTO_DEFLATE=y
CONFIG_CRYPTO_LZO=y
CONFIG_CRC16=y
CONFIG_XZ_DEC=y
```

## arch/arm/mach-meson1/Kconfig.boards
```kconfig
config MACH_M1_8626M_REFC02
    depends on ARCH_MESON1=y
	bool "Support M1 8626(MBOX_8626M1_V1.0) platform"
	help
	  Include support for the AMLOGIC M1 8626M Emulation Baseboard platform.

config MACH_M1_8726M_REFC03
    depends on ARCH_MESON1=y
	bool "Support M1 8726(DVBC_8726M1_V1.0) platform"
	help
	  Include support for the AMLOGIC M1 8726M DVBC Emulation Baseboard platform.
```

## arch/arm/mach-meson2/Kconfig.boards
```kconfig
config MACH_M2_SKT
    depends on ARCH_MESON2=y
	bool "Amlogic Meson2 socket board"
	default y
	help
	  Support Amlogic Meson2 socket development platform.

config MACH_M2_REF
    depends on ARCH_MESON2=y
	bool "Amlogic Meson2 reference board"
	default y
	help
	  Support Amlogic Meson2 reference development platform
```

## arch/arm/mach-meson3/Kconfig.boards
```kconfig
if ARCH_MESON3

config MACH_M3_SKT
	depends on ARCH_MESON3=y
	bool "Meson3 socket board"
	default y
	select I2C_AML
	select AML_HDMI_TX
	select FB_AM
	select FB_OSD2_CURSOR
	select SND_AML_M3
	select USB_DWC_OTG_HCD
	help
	  Support for Amlogic Meson3 socket board.

config MACH_M3_REF
	depends on ARCH_MESON3=y
	bool "Meson3 reference board"
	default y
	help
	  Support for Amlogic Meson3 reference development platform.

endif # ARCH_MESON3
```

## arch/arm/mach-meson6/Kconfig
```kconfig
if ARCH_MESON6

config CLKTREE_DEBUG
	bool "New clock tree debug support"
	default y
	help
		Create a node /sys/class/meson_clocktree/clkTree to get/set clocks
menu    "Meson Timer Setting"
config MESON_TIMERA
	bool "Enable EE Domain Timer A"
	default y
	help
		Enable EE Timer A . if enable the timer is 1Mhz
config MESON_TIMERB
	bool "Enable EE Domain Timer B"
	depends on !SMP || HAVE_ARM_TWD
	default n
	help
		Enable EE Timer B . if enable the timer is 1Mhz
config MESON_TIMERC
	bool "Enable EE Domain Timer C"
	default n
	help
		Enable EE Timer C . if enable the timer is 1Mhz
config MESON_TIMERD
	bool "Enable EE Domain Timer D"
	depends on !SMP || HAVE_ARM_TWD
	default n
	help
		Enable EE Timer D . if enable the timer is 1Mhz
endmenu
choice 
	prompt "Meson Local timer select"
	depends on SMP
	default MESON_LOCAL_TIMER
config  MESON_LOCAL_TIMER
	bool "USE Meson timer "
config  MESON_ARM_TWD
	bool "USE Meson ARM TWD"
	select HAVE_ARM_TWD
endchoice

config CORE_FREQ_TRACK
    bool "trace for cpu frequence with kernel timestamp"
    default n
    help
        Create /dev/core_freq to collect cpu frequent change information with kernel timestamp

config MESON6_SMP_HOTPLUG
	bool "Hotplug support for test"
	depends on SMP
	default n
	help
		Hotplug let cpu1 enter wfi. Wake up it via SGI by cpu0
		
config MESON_L2CC_OPTIMIZE
	bool "Optimize L2 cache"
	depends on SMP && CACHE_L2X0
	default n
	help
		enable PL310 double linefill
		
endif # ARCH_MESON36
```

## arch/arm/mach-meson6/Kconfig.boards
```kconfig
if ARCH_MESON6

config MACH_MESON6_SKT
	depends on ARCH_MESON6
	bool "Meson6 socket board"
	default y 
	help
          Support for Amlogic Meson6 socket board.

config MACH_MESON6_REF
	depends on ARCH_MESON6
	bool "Meson6 reference board"
	default y 
	help
          Support for Amlogic Meson6 reference development platform.

endif # ARCH_MESON6
```

## arch/arm/plat-meson/Kconfig
```kconfig
if PLAT_MESON

menu "Amlogic Meson platform"
	depends on PLAT_MESON
choice 
	prompt "Meson SoC"
	default ARCH_MESON3

config ARCH_MESON1
	bool "Meson1 series"
	help
	  Enable support for Amlogic Meson1 based system

config ARCH_MESON2
	bool "Meson2 series"
	help
	  Enable support for Amlogic Meson2 based system

config ARCH_MESON3
	bool "Meson3 series"
	help
	  Enable support for Amlogic Meson3 based system

config ARCH_MESON6
    bool "Meson6 series"
    help
        Enable support for Amlogic Meson6 based system

endchoice

choice 
	depends on !SMP
	prompt "Meson Interrupt Controller Selector"
	default MESON_IRQ if !ARCH_MESON6
	default MESON_ARM_GIC
config MESON_IRQ
	bool "Meson Interrupt controller"
    help
        If SMP is opend , you should not Enable it 
config MESON_ARM_GIC
	bool "ARM Generic Interrupt Controller"
    select ARM_GIC
    help
        Interrupt Controller from ARM Company 
endchoice
config MESON_CLOCK_TICK_RATE
	int "Clock Tick Rate"
	default 25000000

config MESON_SUSPEND
	bool "Support Meson A9 domain power down"
	depends on SUSPEND && (ARCH_MESON3 || ARCH_MESON6)
	default n

config MESON_SUSPEND_FIRMWARE_BASE
	hex
	default 0x1ff00000
	depends on MESON_SUSPEND
	help
	  The base address of 1MB of memory reserved for suspend firmware.

config HARDWARE_WATCHDOG
	bool "Enable hardware watchdog while system panic"
	depends on MESON_SUSPEND
	default n
	
config SUSPEND_WATCHDOG
	bool "Enable hardware watchdog while system halt in suspend or resume process"
	depends on MESON_SUSPEND && HARDWARE_WATCHDOG
	default n
	
config MESON_SUSPEND_TEST
	bool "Enable suspend/resume test"
	depends on MESON_SUSPEND
	default n
	
config CLK81_DFS
	bool "Scale clk81 freqence in dynamic mode"
	default n

config MESON_LEGACY_REGISTER_API
	bool "Support legacy Meson regiser operation API"
	default n
    help
	  Enable support for legacy Meson register operation API.

config MESON_PLATFORM_API
	bool "New Meson platform structure API (EXPERIMENTAL)"
	depends on EXPERIMENTAL
	default n
	help
	  This is the new Meson platform structure API
source "arch/arm/mach-meson1/Kconfig"
source "arch/arm/mach-meson2/Kconfig"
source "arch/arm/mach-meson3/Kconfig"
source "arch/arm/mach-meson6/Kconfig"

config MESON_CUSTOM_BOARD_SUPPORT
	bool "Support customer board"
	default n
	help
	  This enables board definition from external customer directory

menu "Meson development boards"

source "arch/arm/mach-meson1/Kconfig.boards"
source "arch/arm/mach-meson2/Kconfig.boards"
source "arch/arm/mach-meson3/Kconfig.boards"
source "arch/arm/mach-meson6/Kconfig.boards"

if MESON_CUSTOM_BOARD_SUPPORT
isource "customer/boards/Kconfig"
endif # MESON_CUSTOM_BOARD_SUPPORT

endmenu # "Meson reference boards"

menu "Meson customer board drivers"
depends on MESON_CUSTOM_BOARD_SUPPORT
isource "customer/drivers/Kconfig"
endmenu # "Customer drivers"

endmenu # "Amlogic Meson platform"

endif # PLAT_MESON
```

## customer/boards/Kconfig
```kconfig
#
# Kconfig to support customer boards
#

config MACH_MESON6_G06
	depends on ARCH_MESON6
	bool "Meson6 g06 board"
	help
	  Support for Amlogic Meson6 g06 customer platform.
```

## customer/drivers/Kconfig
```kconfig
#
# Kconfig to support customer board drivers
#
if PLAT_MESON
menu "Device Drivers"

source "customer/drivers/misc/Kconfig"
source "customer/drivers/touchscreen/Kconfig"
source "customer/drivers/net/usb/Kconfig"

endmenu
endif # PLAT_MESON
```

## customer/drivers/misc/Kconfig
```kconfig
#
# Misc strange devices
#

menuconfig MISC_DEVICES
	bool "Misc devices"
	---help---
	  Say Y here to get to see options for device drivers from various
	  different categories. This option alone does not add any kernel code.

	  If you say N, all options in this submenu will be skipped and disabled.

if MISC_DEVICES

config BOSCH_BMA250
	tristate "BMA250 acceleration sensor support"
	depends on I2C=y
	help
	  If you say yes here you get support for Bosch Sensortec's 
	  acceleration sensors BMA250.
	  NOT memsic solution

config BOSCH_BMA222
	tristate "BMA222 acceleration sensor support"
	depends on I2C=y
	help
	  If you say yes here you get support for Bosch Sensortec's 
	  acceleration sensors BMA222.

config BOSCH_BMA250_MEMSIC
	tristate "MEMSIC BMA250 acceleration sensor support"
	depends on I2C=y
	help
	  If you say yes here you get support for Bosch Sensortec's 
	  acceleration sensors BMA250.
	  
config SENSORS_MMA8452
	tristate "MEMSIC Accelerometer Sensor MMA8452 Driver Support"
	depends on I2C
	help
	  If you say yes here you get support for the MEMSIC accelerometer sensor
	  
config SENSORS_MMA7660
	tristate "MEMSIC Accelerometer Sensor MMA7660 Driver Support"
	depends on I2C
	help
	  If you say yes here you get support for the MEMSIC accelerometer sensor

config SENSORS_MMC314X
	tristate "MEMSIC MMC314X magnetic sensor support"
	depends on I2C=y
	help
	  If you say yes here you get support for MEMSIC's 
	  magnetic sensors MMC314X.
config SENSORS_MMC328X
	tristate "MEMSIC MMC328X magnetic sensor support"
	depends on I2C=y
	help
	  If you say yes here you get support for MEMSIC's 
	  magnetic sensors MMC328XMS.

config SENSORS_MMC328XMA
	tristate "MEMSIC MMC328XMA magnetic sensor support"
	depends on I2C=y
	help
	  If you say yes here you get support for MEMSIC's 
	  magnetic sensors MMC328XMA.
config ECOMPASS
	tristate "MEMSIC eCompass Driver Support"
	depends on I2C
	help
	  If you say yes here you get support for the MEMSIC eCompass
	  


endif # MISC_DEVICES
```
